## conf/layer.conf
```bitbake
# We have a conf and classes directory, add to BBPATH
BBPATH .= ":${LAYERDIR}"

# We have recipes-* directories, add to BBFILES
BBFILES += "${LAYERDIR}/recipes-*/*/*.bb \
            ${LAYERDIR}/recipes-*/*/*.bbappend"

BBFILE_COLLECTIONS += "meta-electone"
BBFILE_PATTERN_meta-electone = "^${LAYERDIR}/"
BBFILE_PRIORITY_meta-electone = "6"

LAYERDEPENDS_meta-electone = "core"
LAYERSERIES_COMPAT_meta-electone = "kirkstone"
```
